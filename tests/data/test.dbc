VERSION ""

NS_ :

BS_:

BU_: ECU1 ECU2

BO_ 291 EngineData: 8 ECU1
 SG_ CoolantTemp : 16|8@1+ (1,-40) [-40|215] "degC"  ECU2
 SG_ EngineSpeed : 0|16@1+ (0.25,0) [0|16383.75] "rpm"  ECU2
